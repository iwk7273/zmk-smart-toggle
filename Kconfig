## Kconfig
```kconfig
DT_COMPAT_ZMK_BEHAVIOR_SMART_TOGGLE := zmk,behavior-smart-toggle

config ZMK_BEHAVIOR_SMART_TOGGLE
    bool
    default $(dt_compat_enabled,$(DT_COMPAT_ZMK_BEHAVIOR_SMART_TOGGLE))
```

## dts/bindings/behaviors/zmk,behavior-smart-toggle.yaml
```yaml
# Copyright (c) 2024 The ZMK Contributors
# SPDX-License-Identifier: MIT

description: Smart toggle behavior

compatible: "zmk,behavior-smart-toggle"

include: zero_param.yaml

properties:
  bindings:
    type: phandle-array
    required: true
    description: |
      First binding is run when the toggle is activated, and the second binding is
      run when the toggle position is pressed again while active.
  ignored-key-positions:
    type: array
    required: false
    default: []
  position-bindings:
    type: array
    required: false
    default: []
    description: |
      List of key positions that should invoke the additional bindings defined in
      `position-binding-behaviors` while the toggle is active. The number of entries
      must match `position-binding-behaviors`.
  position-binding-behaviors:
    type: phandle-array
    required: false
    default: []
    description: |
      Additional behavior bindings that may be triggered while the toggle is active.
      Each entry uses the same format as `bindings` and is paired with the corresponding
      entry in `position-bindings`.
```
